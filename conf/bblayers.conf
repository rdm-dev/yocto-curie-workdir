## conf/bblayers.conf
```bitbake
LCONF_VERSION = "6"

BBPATH = "${TOPDIR}"
BSPDIR := "${@os.path.abspath(os.path.dirname(d.getVar('FILE', True)) + '/../..')}"

BBFILES ?= ""
BBLAYERS = " \
  ${BSPDIR}/sources/poky/meta \
  ${BSPDIR}/sources/poky/meta-yocto \
  \
  ${BSPDIR}/sources/meta-openembedded/meta-oe \
  ${BSPDIR}/sources/meta-openembedded/meta-webserver \
  ${BSPDIR}/sources/meta-openembedded/meta-networking \
  ${BSPDIR}/sources/meta-openembedded/meta-filesystems \
  \
  ${BSPDIR}/sources/meta-fsl-arm \
  ${BSPDIR}/sources/meta-fsl-arm-extra \
  ${BSPDIR}/sources/meta-fsl-demos \
"
# Adds browsers
BBLAYERS += " ${BSPDIR}/sources/meta-browser "
# required for meta-browser
BBLAYERS += " ${BSPDIR}/sources/meta-openembedded/meta-gnome "
## XBMC
# BBLAYERS += " ${BSPDIR}/sources/meta-stef "
## Perl
BBLAYERS += " ${BSPDIR}/sources/meta-cpan "
## JAVA
BBLAYERS += " ${BSPDIR}/sources/meta-java "
# BBLAYERS += " ${BSPDIR}/sources/meta-oracle-java "
## Own layer for BSP and stuff
BBLAYERS += " ${BSPDIR}/sources/meta-jens "
```

## conf/local.conf
```bitbake
MACHINE ??= "curie"
DISTRO ?= 'rdm'
#EXTRA_IMAGE_FEATURES += "debug-tweaks"
PATCHRESOLVE = "noop"
BB_DISKMON_DIRS = "\
    STOPTASKS,${TMPDIR},1G,100K \
    STOPTASKS,${DL_DIR},1G,100K \
    STOPTASKS,${SSTATE_DIR},1G,100K \
    ABORT,${TMPDIR},100M,1K \
    ABORT,${DL_DIR},100M,1K \
    ABORT,${SSTATE_DIR},100M,1K" 
CONF_VERSION = "1"

BB_NUMBER_THREADS = "${@oe.utils.cpu_count() * 2}"
PARALLEL_MAKE = "-j ${@oe.utils.cpu_count() * 2}"

DL_DIR ?= "${BSPDIR}/downloads/"
ACCEPT_FSL_EULA = "1"

#include include/xbmc_13.inc
include include/kodi_14.inc

FILESYSTEM_PERMS_TABLES = "files/rdm-perms.txt"

#INHERIT += "buildhistory"
#BUILDHISTORY_COMMIT = "0"
#BUILDHISTORY_FEATURES = "image"

#WANTED_ROOT_DEV = "usb"
```
